## ESP-IDF/practice-project/Kconfig.simple
```kconfig
menu "Project Configuration"
    config LED_GPIO_PIN
        int "LED GPIO Pin Number"
        range 0 39
        default 2
        help
            GPIO pin number for the status LED.
    
    config BUTTON_GPIO_PIN
        int "Button GPIO Pin Number" 
        range 0 39
        default 0
        help
            GPIO pin number for the push button.
endmenu
```

## ESP-IDF/practice-project/sdkconfig.defaults
```kconfig
# Default configuration for Smart Environment Data Logger
# This file contains default values for Kconfig options

# Enable Long File Name support for FAT filesystem
CONFIG_FATFS_LFN=y
CONFIG_FATFS_LFN_CONF=2

# GPIO Configuration
CONFIG_LED_GPIO_PIN=2
CONFIG_LED_ACTIVE_LEVEL=y
CONFIG_BUTTON_GPIO_PIN=0
CONFIG_BUTTON_ACTIVE_LEVEL=n
CONFIG_BUTTON_DEBOUNCE_TIME_MS=50
CONFIG_BUTTON_LONG_PRESS_TIME_MS=1000
CONFIG_BUTTON_DOUBLE_CLICK_TIMEOUT_MS=300

# Sensor Configuration
CONFIG_DHT22_GPIO_PIN=4
CONFIG_MPU6050_I2C_SDA_PIN=21
CONFIG_MPU6050_I2C_SCL_PIN=22
CONFIG_MPU6050_I2C_ADDR_DEFAULT=y
CONFIG_MPU6050_I2C_FREQUENCY=400000
CONFIG_MPU6050_ACCEL_2G=y
CONFIG_MPU6050_GYRO_250DPS=y
CONFIG_MPU6050_DLPF_44HZ=y
CONFIG_MPU6050_ENABLE_CALIBRATION=y
CONFIG_MPU6050_CALIBRATION_SAMPLES=1000
CONFIG_MPU6050_ENABLE_STATISTICS=y
CONFIG_MPU6050_ENABLE_DEBUG_LOGGING=n

# Storage Configuration
CONFIG_SD_CARD_SPI_CS_PIN=5
CONFIG_SD_CARD_SPI_MOSI_PIN=23
CONFIG_SD_CARD_SPI_MISO_PIN=19
CONFIG_SD_CARD_SPI_CLK_PIN=18

# Network Configuration
CONFIG_WIFI_SSID="your_wifi_ssid"
CONFIG_WIFI_PASSWORD="your_wifi_password"
CONFIG_MQTT_BROKER_URI="mqtt://mqtt.broker.address:1883"
CONFIG_MQTT_TOPIC_PREFIX="smart_logger"

# Application Settings
CONFIG_SENSOR_READ_INTERVAL_MS=5000
CONFIG_DATA_LOG_INTERVAL_MS=10000
CONFIG_MQTT_PUBLISH_INTERVAL_MS=30000
```
